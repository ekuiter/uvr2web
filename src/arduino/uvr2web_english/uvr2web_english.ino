/*  
 ~~~~~~~
 uvr2web
 ~~~~~~~
 © Elias Kuiter 2013 (http://elias-kuiter.de)
 
 uvr2web.ino:
 Phase change between receiving and processing
 
 */

// If DEBUG is defined all dump commands (dump.h/dump.ino) are compiled and 
// output occurs via Serial. If DEBUG is commented out, the web upload 
// (web.h/web.ino) is compiled and used instead. Both at once doesn't work
// (on the Leonardo) because the RAM storage is too small.
//#define DEBUG

#include <SPI.h>
#include <Ethernet.h>

#include "receive.h"
#include "process.h"
#include "dump.h"
#include "web.h"

// Maybe adjust these values:

const byte dataPin = 2; // pin with data stream
// interrupt for data pin, see: http://arduino.cc/en/Reference/AttachInterrupt
const byte interrupt = 1;
byte mac[] = {
  0x90, 0xa2, 0xda, 0x0d, 0xb4, 0x95  }; // MAC address of Ethernet board
char server[] = "example.com"; // server address
char script[] = "http://uvr2web.example.com/upload.php"; // upload script
// Maybe use the one generated by the PHP app, as long as they are the same.
char pass[] = "123456789examplepassword123456789aslongaspossible";
// Additional delay time between two uploads. If 0, the maximal upload rate is about 3 seconds.
// In this example 7000 ms, so 3s + 7s = 10 seconds per upload.
// Use the same value as in the PHP app.
int upload_interval = 7000;

void setup() {
  Serial.begin(115200);
  // in DEBUG mode output via serial, otherwise web upload (see above)
#ifdef DEBUG
  while (!Serial); // only for Leonardo
  Serial.println("Press key for detailed output.");
#else
  Web::start();  
#endif

  Receive::start();
}

void loop() {
  if (!Receive::receiving) {
    Process::start(); // process data
    Receive::start(); // receive data
  }

#ifdef DEBUG
  if (Serial.available()) {
    while (Serial.available())
      Serial.read(); 
    if (Dump::active)
      Serial.println("\nDetails deactivated.");
    else
      Serial.println("\nDetails activated.");
    Dump::active = !Dump::active;
  }
#endif
}




































